## CMakeLists.txt
```
cmake_minimum_required(VERSION 3.20.0)
find_package(Zephyr REQUIRED HINTS $ENV{ZEPHYR_BASE})
project(dut_stm32_2)
target_sources(app PRIVATE src/main.c src/spi_slave.c)
target_include_directories(app PRIVATE src)
```

## prj.conf
```kconfig
CONFIG_SPI=y
CONFIG_SPI_SLAVE=y
CONFIG_GPIO=y
CONFIG_PRINTK=y
CONFIG_UART_CONSOLE=y
```

## boards/blackpill_f401cc.overlay
```dts
&spi1 {
    status = "okay";
    pinctrl-0 = <&spi1_sck_pa5 &spi1_nss_pa4
                 &spi1_miso_pa6 &spi1_mosi_pa7>;
    pinctrl-names = "default";
};
```

## src/main.c
```c
#include <zephyr/kernel.h>
#include "spi_slave.h"

int main(void)
{
    printk("DUT2 SPI Slave starting\n");
    if (spi_slave_init() != 0) return 0;
    spi_slave_run();
    return 0;
}
```

## src/spi_slave.c
```c
#include "spi_slave.h"
#include <zephyr/kernel.h>
#include <zephyr/drivers/spi.h>
#include <string.h>

static const struct device *spi_dev;

static const struct spi_config slave_cfg = {
    .frequency = 100000,
    .operation = SPI_OP_MODE_SLAVE |
                 SPI_TRANSFER_MSB  |
                 SPI_WORD_SET(8)   |
                 SPI_LINES_SINGLE,
    .slave = 0,
};

int spi_slave_init(void)
{
    spi_dev = DEVICE_DT_GET(DT_NODELABEL(spi1));
    if (!device_is_ready(spi_dev)) {
        printk("SPI slave not ready\n");
        return -1;
    }
    printk("SPI slave ready\n");
    return 0;
}

void spi_slave_run(void)
{
    static const char tx_data[] = "PONG";
    static char       rx_data[8];

    while (1) {
        memset(rx_data, 0, sizeof(rx_data));

        struct spi_buf tx_buf = { .buf = (void *)tx_data, .len = 4 };
        struct spi_buf rx_buf = { .buf = rx_data,         .len = 4 };

        struct spi_buf_set tx_set = { .buffers = &tx_buf, .count = 1 };
        struct spi_buf_set rx_set = { .buffers = &rx_buf, .count = 1 };

        int ret = spi_transceive(spi_dev, &slave_cfg, &tx_set, &rx_set);
        if (ret == 0) {
            printk("RX: %s TX: PONG\n", rx_data);
        } else {
            printk("SPI error: %d\n", ret);
        }
    }
}
```

## src/spi_slave.h
```c
#ifndef SPI_SLAVE_H
#define SPI_SLAVE_H
int  spi_slave_init(void);
void spi_slave_run(void);
#endif
```
